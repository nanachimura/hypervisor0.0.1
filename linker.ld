ENTRY(start)              /* точка входа — символ start из boot.S */

SECTIONS
{
    /* Расположим код и данные по физическому адресу 0x0010_0000 (1 MiB) */
    . = 0x00100000;       

    .text : {
        *(.text*)         /* все секции .text из ваших объектов */
    }

    .rodata : {
        *(.rodata*)       /* константы */
    }

    .data : {
        *(.data*)         /* инициализированные данные */
    }

    .bss : {
        __bss_start = .;
        *(.bss*)          /* неинициализированные данные */
        *(COMMON)
        __bss_end = .;
    }

    /* Выравнивание на 16 байт для стека */
    . = ALIGN(16);
    PROVIDE(stack_bottom = .);
    .stack : {
        . = . + 8192;     /* резервируем 8 KiB под стек */
    }
    PROVIDE(stack_top = .);
}